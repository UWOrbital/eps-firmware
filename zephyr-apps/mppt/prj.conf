## CMakeLists.txt
```
# SPDX-License-Identifier: Apache-2.0

cmake_minimum_required(VERSION 3.20.0)

find_package(Zephyr HINTS $ENV{ZEPHYR_BASE})
project(mppt)

FILE(GLOB app_sources src/*.c)
target_sources(app PRIVATE ${app_sources})
```

## prj.conf
```kconfig
CONFIG_GPIO=y
CONFIG_STDOUT_CONSOLE=y
CONFIG_LOG=y
CONFIG_SERIAL=y
CONFIG_ADC=y
CONFIG_ADC_ASYNC=y
```

## src/main.c
```c
#include <zephyr/kernel.h>
#include <zephyr/drivers/gpio.h>
#include <zephyr/logging/log.h>

#include "adc.h"
#include "eFuse.h"
#include "mppt.h"

LOG_MODULE_REGISTER(mppt, LOG_LEVEL_INF);

/* 1000 msec = 1 sec */
#define SLEEP_TIME_MS   5000

/* The devicetree node identifier for the "led0" alias. */
#define LED0_NODE DT_ALIAS(led0)

/*
Initialize GPIO LED
*/
static const struct gpio_dt_spec led = GPIO_DT_SPEC_GET(LED0_NODE, gpios);

void main(void)
{
	int ret;

	if (!device_is_ready(led.port)) {
		return;
	}

	ret = gpio_pin_configure_dt(&led, GPIO_OUTPUT_ACTIVE);
	if (ret < 0) {
		return;
	}

	// Configure adc
	ret = setup_adc();
	if (ret < 0) {
		return;
	}

	// Configure efuse
	ret = efuse_init();
	if (ret < 0) {
		return;
	}

	// toggle for testing
	uint8_t toggle = 0; 

	while (1) {

		LOG_INF("Running Main(%"PRId32")...", toggle);

		// test toggling gpio pin c14 
		if (toggle == 1) {
			LOG_INF("set_eFuse_high()");
			set_eFuse_high();
		} else{
			LOG_INF("set_eFuse_low()");
			set_eFuse_low();
		}
		
		// commented out for now
		read_adc_channels();

		// Read current
		float current = get_current_reading(10);

		ret = gpio_pin_toggle_dt(&led);
		if (ret < 0) {
			return;
		}
		
		k_msleep(SLEEP_TIME_MS);
		toggle ^= 1; // flip toggle bit

	}
}
```

## src/adc.c
```c
#include <zephyr/logging/log.h>

#include "adc.h"

LOG_MODULE_REGISTER(mppt_adc, LOG_LEVEL_INF);

// For current sensor readings
#define CURRENT_SENSOR_GAIN -1.5 

// In mV
#define REFERENCE_VOLTAGE 2550 

/* Data of ADC io-channels specified in devicetree. */
static const struct adc_dt_spec adc_channels[] = {
	DT_FOREACH_PROP_ELEM(DT_PATH(zephyr_user), io_channels,
			     DT_SPEC_AND_COMMA)
};

static int16_t buf;
static struct adc_sequence sequence = {
	.buffer      = &buf,
	/* buffer size in bytes, not number of samples */
	.buffer_size = sizeof(buf),
};

int8_t setup_adc(){

	int8_t err = 0;
	
	/* Configure channels individually prior to sampling. */
	for (uint8_t i = 0; i < ARRAY_SIZE(adc_channels); i++) {
		if (!device_is_ready(adc_channels[i].dev)) {
			LOG_ERR("ADC device not found \n");
			return -ENODEV;
		}

		err = adc_channel_setup_dt(&adc_channels[i]);
		if (err < 0) {
			printk("Could not setup channel #%d (%d)\n", i, err);
			return -ENODEV;
		}
		LOG_INF("ADC(%s), channel [%d]: Configured", adc_channels[i].dev->name, adc_channels[i].channel_id);
	}

	return err;
}

void read_adc_channels(){

	int err; 
	int32_t val_mv;
	
	for (size_t i = 0U; i < ARRAY_SIZE(adc_channels); i++) {

		LOG_INF("- %s, channel %d: ",
				adc_channels[i].dev->name,
				adc_channels[i].channel_id);

		(void)adc_sequence_init_dt(&adc_channels[i], &sequence);

		err = adc_read(adc_channels[i].dev, &sequence);
		if (err < 0) {
			LOG_INF("Could not read (%d)\n", err);
			continue;
		} else {
			LOG_INF("%"PRId16, buf);
		}

		/* conversion to mV may not be supported, skip if not */
		val_mv = buf;
		err = adc_raw_to_millivolts_dt(&adc_channels[i],
							&val_mv);
		if (err < 0) {
			LOG_INF(" (value in mV not available)\n");
		} else {
			LOG_INF(" = %"PRId32" mV\n", val_mv);
		}
	}
}

int32_t read_adc_channel(int8_t chn){

	int err; 
	int32_t val_mv;
	
	(void)adc_sequence_init_dt(&adc_channels[chn], &sequence);

	err = adc_read(adc_channels[chn].dev, &sequence);
	if (err < 0) {
		LOG_INF("Could not read (%d)\n", err);
	} 

	/* conversion to mV may not be supported, skip if not */
	val_mv = buf;
	err = adc_raw_to_millivolts_dt(&adc_channels[chn], &val_mv);
	if (err < 0) {
		LOG_INF(" (value in mV not available)\n");
	} 	

	return val_mv;
}

float get_current_reading(int8_t num_samples){
	
	int8_t channel_num = 0; 
	int32_t avgVal_mV = 0; 

	for (int8_t i = 0; i < num_samples; i++){
		
		// Get reading in mV
		avgVal_mV += read_adc_channel(channel_num); 
	}

	// Get readings average
	avgVal_mV = avgVal_mV / num_samples; 
	
	LOG_INF("Current Reading(mV) = %"PRId32" mV\n", avgVal_mV);

	// Perform conversion
	float current = (avgVal_mV - REFERENCE_VOLTAGE)*CURRENT_SENSOR_GAIN;

	LOG_INF("Current = %"PRId32" mA", (int32_t)current);

	return current; 

}
```

## src/adc.h
```c
#include <inttypes.h>
#include <stddef.h>
#include <stdint.h>

#include <zephyr/device.h>
#include <zephyr/devicetree.h>
#include <zephyr/drivers/adc.h>
#include <zephyr/kernel.h>
#include <zephyr/sys/printk.h>
#include <zephyr/sys/util.h>

#if !DT_NODE_EXISTS(DT_PATH(zephyr_user)) || \
	!DT_NODE_HAS_PROP(DT_PATH(zephyr_user), io_channels)
#error "No suitable devicetree overlay specified"
#endif

#define DT_SPEC_AND_COMMA(node_id, prop, idx) \
	ADC_DT_SPEC_GET_BY_IDX(node_id, idx),

int8_t setup_adc();

void read_adc_channels();

int32_t read_adc_channel(int8_t chn);

float get_current_reading(int8_t num_samples);
```

## src/can-driver.c
```c
#include "can-driver.h"


void initialize_CAN();
{

}

void read_CAN_signal();
{

}

int8_t write_CAN_signal(int msg)
{
    //can send  = Perform data transfer to CAN bus.
    //can write = Write a set amount of data to the can bus.
    
    //make sure message is less <= 64 bits
    //timeout = Waiting for empty tx mailbox timeout in ms or K_FOREVER.
    
    ret = can_send(*dev, *msg, timeout, can_tx_callback_tcallback_isr)
    return ret
}
```

## src/can-driver.h
```c
#include <zephyr/logging>
#include <zephyr/device.h>
#include <zephyr/devicetree.h>
#include <zephyr/can.h>

#define SUCCESS 1

//
void initialize_CAN();

void read_CAN_signal();

int8_t write_CAN_signal(int msg);
```

## src/eFuse.c
```c
#include "eFuse.h"

LOG_MODULE_REGISTER(mppt_efuse, LOG_LEVEL_INF);

//Defaults pin c14 to active at high voltage
const struct gpio_dt_spec sig0 = GPIO_DT_SPEC_GET(DT_PATH(zephyr_user), signal_gpios);

// Initialize e-fuse
int8_t efuse_init(void)
{
    int8_t ret; 

    if (!device_is_ready(sig0.port)) {
		return -EIO;
	}

    // Initialize to be low state
    ret = gpio_pin_configure_dt(&sig0, GPIO_OUTPUT_LOW);
	if (ret < 0) {
		return -EIO;
    }

    LOG_INF("E-fuse initialized: GPIO_OUTPUT_LOW");

    return SUCCESS;
}

// Read E-Fuse pins
int8_t get_efuse_state(void)
{
    int8_t current_state;
    
    current_state = gpio_pin_get_dt(&sig0);
    if (current_state < 0) {
        return -EIO;
    }
    
    LOG_DBG("E-fuse current state is (%i)\n", current_state);
    return current_state;
}

//Pull E-Fuse pins to ground via open drain
int8_t set_eFuse_low(void)
{
    int8_t ret;
    int8_t current_state = get_efuse_state();
      
    if(current_state != 1) {
        LOG_DBG("E-fuse pin is already disabled\n");
        return SUCCESS;
    }
    else
    {
        ret = gpio_pin_configure_dt(&sig0, GPIO_OUTPUT_LOW);
        if (ret < 0) {
            return -EIO;
        }    
    }
    
    current_state = get_efuse_state();
    if(current_state != 0) return -EIO;

    LOG_INF("E-fuse had been disabled, state: [%i]\n", current_state);

    return current_state;
	
}

// Pull E-Fuse pins high
int8_t set_eFuse_high()
{
    int8_t ret;
    int8_t current_state = get_efuse_state();

	if (!device_is_ready(sig0.port)) {
		return -EIO;
	}

    if(current_state != 0) {
        LOG_DBG("E-fuse pin is already enabled\n");
        return -EIO;
    }
    else
    {
        ret = gpio_pin_configure_dt(&sig0, GPIO_OUTPUT_HIGH);
        if (ret < 0) {
            return -EIO;
        } 
    }
    
    current_state = get_efuse_state();
    if(current_state != 1) return -EIO;
    
    LOG_INF("E-fuse had been enabled, state: [%i]\n", current_state);

    return current_state;
}
```

## src/eFuse.h
```c
//#include <zephyr/zephyr.h>
#include <zephyr/kernel.h>
#include <zephyr/drivers/gpio.h>
#include <zephyr/logging/log.h>

// Find devicetree configurations
#if !DT_NODE_EXISTS(DT_PATH(zephyr_user)) || \
	!DT_NODE_HAS_PROP(DT_PATH(zephyr_user), signal_gpios)
#error "No suitable devicetree overlay specified"
#endif

#define SUCCESS 1

/*
* Initialize efuse to a low state. 
*/
int8_t efuse_init(void);

/*
* Read the state of the efuse. 
* Returns -EIO if there is and error.  
*/
int8_t get_efuse_state(void);

/*
* Read the state of the efuse. 
* Returns -EIO if there is and error, otherwise returns the current state.  
*/
int8_t set_eFuse_low(void); 

/*
* Read the state of the efuse. 
* Returns -EIO if there is and error, otherwise returns the current state.  
*/
int8_t set_eFuse_high(void);
```

## src/mppt.c
```c
#include "adc.h"
#include "mppt.h" 

float calc_dv(float t_delta, float v0, float v1){}

float calc_di(float t_delta, float i0, float i1){}

float measure_voltage(){}

float measure_current(){}

void init_mppt(){}

void run_mppt(){}

int calc_mppt(){}
```

## src/mppt.h
```c
#include <inttypes.h>
#include <stddef.h>
#include <stdint.h>

#include <zephyr/device.h>
#include <zephyr/devicetree.h>
#include <zephyr/kernel.h>

float calc_dv(float t_delta, float v0, float v1);

float calc_di(float t_delta, float i0, float i1);

float measure_voltage();

float measure_current();

void init_mppt();

void run_mppt();

int calc_mppt();
```
